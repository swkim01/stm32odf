## components/boards/Kconfig
```kconfig
menu "Board config"

	choice BOARD
		bool "Select board"
		default BOARD_NUCLEO_STM32F446RE
		config BOARD_NUCLEO_STM32F446RE
			depends on ARCH_STM32F4 && ARCH_STM32F446RE
			bool "Select Nucleo STM32F446RE board"

		config BOARD_NUCLEO_STM32F401RE
			depends on ARCH_STM32F4 && ARCH_STM32F401RE
			bool "Select Nucleo STM32F401RE board"

		config BOARD_NUCLEO_STM32F429ZI
			depends on ARCH_STM32F4 && ARCH_STM32F429ZI
			bool "Select Nucleo STM32F429ZI board"

		config BOARD_BLACKPILL_STM32F411CE
			depends on ARCH_STM32F4 && ARCH_STM32F411CE
			bool "Select BlackPill STM32F411CE board"

		config BOARD_NUCLEO_STM32F103RB
			depends on ARCH_STM32F1 && ARCH_STM32F103RB
			bool "Select Nucleo STM32F103RB board"

		config BOARD_BLUEPILL_STM32F103C8
			depends on ARCH_STM32F1 && ARCH_STM32F103C8
			bool "Select BluePill STM32F103C8 board"

		config BOARD_BLUEPILL_STM32F103C6
			depends on ARCH_STM32F1 && ARCH_STM32F103C6
			bool "Select BluePill STM32F103C6 board"

		config BOARD_BLUEPILL_STM32F103CB
			depends on ARCH_STM32F1 && ARCH_STM32F103CB
			bool "Select BluePill STM32F103CB board"

	endchoice

	config CLOCK_FREQ
		int "clock(xclk) frequency"
		default 180000000

endmenu
```

## components/drivers/Kconfig
```kconfig
config LIB_DRIVERS_ENABLE
	bool "Enable stm32 drivers component"
	default n
menu "STM32 DRIVERS configurations"
	depends on LIB_DRIVERS_ENABLE

	menu "GPIO"
		config GPIO_DRIVER_MODULE_ENABLED
		depends on HAL_GPIO_MODULE_ENABLED
			bool "GPIO Driver Module"
			default y
	endmenu
	menu "EXTI"
		config EXTI_DRIVER_MODULE_ENABLED
		depends on HAL_EXTI_MODULE_ENABLED
			bool "EXTI Driver Module"
			default y
	endmenu
	menu "I2C"
		config I2C_DRIVER_MODULE_ENABLED
		depends on HAL_I2C_MODULE_ENABLED
		depends on GPIO_DRIVER_MODULE_ENABLED
			bool "I2C Driver Module"
			default n
	endmenu
	menu "SPI"
		config SPI_DRIVER_MODULE_ENABLED
		depends on HAL_SPI_MODULE_ENABLED
		depends on GPIO_DRIVER_MODULE_ENABLED
			bool "SPI Driver Module"
			default n
	endmenu
	menu "CLCD"
		config CLCD_DRIVER_MODULE_ENABLED
		depends on HAL_I2C_MODULE_ENABLED
			bool "CLCD Driver Module"
			default n
	endmenu
	menu "ADC"
		config ADC_DRIVER_MODULE_ENABLED
		depends on HAL_ADC_MODULE_ENABLED
			bool "ADC Driver Module"
			default n
	endmenu
	menu "MPU6050"
		config MPU6050_DRIVER_MODULE_ENABLED
		depends on HAL_I2C_MODULE_ENABLED
			bool "MPU6050 Driver Module"
			default n
	endmenu
	menu "SSD1306"
		config SSD1306_DRIVER_MODULE_ENABLED
		depends on HAL_I2C_MODULE_ENABLED
			bool "SSD1306 Driver Module"
			default n
	endmenu
	menu "SSD1331"
		config SSD1331_DRIVER_MODULE_ENABLED
		depends on HAL_SPI_MODULE_ENABLED
			bool "SSD1331 Driver Module"
			default n
	endmenu
endmenu
```

## components/freertos/Kconfig
```kconfig
config LIB_FREERTOS_ENABLE
        bool "Enable freertos component"
        default n
menu "FreeRTOS"
    depends on LIB_FREERTOS_ENABLE

    choice FREERTOS_INTERFACE_MODE
        prompt "FreeRTOS Interface Mode"
        default FREERTOS_NO_INTERFACE_MODE
        help
            FreeRTOS Interface Mode
        config FREERTOS_NO_INTERFACE_MODE
            bool "No Interface"
        config FREERTOS_CMSIS_RTOS_V1
            bool "CMSIS RTOS V1 Interface"
        config FREERTOS_CMSIS_RTOS_V2
            bool "CMSIS RTOS V2 Interface"
    endchoice # FREERTOS_INTERFACE_MODE

endmenu # FreeRTOS
```

## components/stm32hal/Kconfig
```kconfig
config LIB_STM32HAL_ENABLE
	bool "Enable stm32 hal component"
	default y

osource "${SDK_PATH}/components/stm32hal/bsp/Kconfig"

menu "STM32 HAL configurations"
	depends on LIB_STM32HAL_ENABLE

	menu "UART"
		config HAL_UART_MODULE_ENABLED
			bool "HAL Uart Module"
			default y
	endmenu
	menu "GPIO"
		config HAL_GPIO_MODULE_ENABLED
			bool "HAL GPIO Module"
			default y
	endmenu
	menu "EXTI"
		config HAL_EXTI_MODULE_ENABLED
			bool "HAL EXTI Module"
			default y
	endmenu
	menu "DMA"
		config HAL_DMA_MODULE_ENABLED
			bool "HAL DMA Module"
			default y
	endmenu
	menu "RCC"
		config HAL_RCC_MODULE_ENABLED
			bool "HAL RCC Module"
			default y
	endmenu
	menu "PWR"
		config HAL_PWR_MODULE_ENABLED
			bool "HAL PWR Module"
			default y
	endmenu
	menu "FLASH"
		config HAL_FLASH_MODULE_ENABLED
			bool "HAL FLASH Module"
			default y
	endmenu
	menu "CORTEX"
		config HAL_CORTEX_MODULE_ENABLED
			bool "HAL CORTEX Module"
			default y
	endmenu
	menu "TIM"
		config HAL_TIM_MODULE_ENABLED
			bool "HAL TIM Module"
			default y
	endmenu
	menu "ADC"
		config HAL_ADC_MODULE_ENABLED
			bool "HAL ADC Module"
			default n
	endmenu
	menu "I2C"
		config HAL_I2C_MODULE_ENABLED
			bool "HAL I2C Module"
			default n
	endmenu
	menu "SPI"
		config HAL_SPI_MODULE_ENABLED
			bool "HAL SPI Module"
			default n
	endmenu

	config SDK_LOG_LEVEL
		int "log level, 5:LOG_VERBOSE, 4:LOG_DEBUG, 3:LOG_INFO, 2:LOG_WARN, 1:LOG_ERROR, 0:LOG_NONE"
		range 0 5
		default 5
endmenu
```

## components/stm32hal/bsp/Kconfig
```kconfig
menu "Platform Selection"

choice ARCH
    prompt "Architecture"
    default ARCH_STM32F4

    config ARCH_STM32F4
    bool "STM32F4"
    help
        Enable for STM32F4 systems

    config ARCH_STM32F1
    bool "STM32F1"
    help
        Enable for STM32F1 systems

endchoice

source "${SDK_PATH}/components/stm32hal/bsp/STM32F1xx/Kconfig"
source "${SDK_PATH}/components/stm32hal/bsp/STM32F4xx/Kconfig"

endmenu
```

## components/stm32hal/bsp/STM32F1xx/Kconfig
```kconfig
if ARCH_STM32F1

choice
    prompt "MCU"
    default ARCH_STM32F103RB

config ARCH_STM32F103RB
    bool "STM32F103RB 128KB"
    select FLASH_SIZE_128KB
    select RAM_SIZE_20KB
    select ARCH_STM32F103
config ARCH_STM32F103C6
    bool "STM32F103C6 32KB"
    select FLASH_SIZE_32KB
    select RAM_SIZE_10KB
    select ARCH_STM32F103
config ARCH_STM32F103C8
    bool "STM32F103C8 64KB"
    select FLASH_SIZE_64KB
    select RAM_SIZE_20KB
    select ARCH_STM32F103
config ARCH_STM32F103CB
    bool "STM32F103CB 128KB"
    select FLASH_SIZE_128KB
    select RAM_SIZE_20KB
    select ARCH_STM32F103

endchoice

endif
```

## components/stm32hal/bsp/STM32F4xx/Kconfig
```kconfig
if ARCH_STM32F4

choice
    prompt "MCU"
    default ARCH_STM32F446RE

config ARCH_STM32F446RE
    bool "STM32F446RE 512KB"
    select FLASH_SIZE_512KB
    select RAM_SIZE_128KB
    select ARCH_STM32F446
config ARCH_STM32F401RE
    bool "STM32F401RE 512KB"
    select FLASH_SIZE_512KB
    select RAM_SIZE_96KB
    select ARCH_STM32F401
config ARCH_STM32F429ZI
    bool "STM32F429ZI 2MB"
    select FLASH_SIZE_2MB
    select RAM_SIZE_256KB
    select ARCH_STM32F429
config ARCH_STM32F411CE
    bool "STM32F411CE 512KB"
    select FLASH_SIZE_512KB
    select RAM_SIZE_128KB
    select ARCH_STM32F411

endchoice

endif
```
